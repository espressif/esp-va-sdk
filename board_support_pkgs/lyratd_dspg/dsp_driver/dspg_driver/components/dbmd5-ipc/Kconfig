## board_support_pkgs/lyratd_dspg/dsp_driver/dspg_driver/components/dbmd5-ipc/Kconfig
```kconfig
menu "DSPG Configuration"

config ENABLE_DSPG_REC
    bool "Enable Debug audio record over UART"

config ENABLE_DSPG_DEBUG
    bool "Enable Debug logs over UART"
endmenu
```

## components/audio_hal/audio_board/audio_board_m5_core2_aws/audio_board/Kconfig
```kconfig
menu "M5Stack Core2 AWS board specific options"

config HALF_DUPLEX_I2S_MODE
    bool "Choose Half Duplex I2S mode: Speaker and Mic do not work together on this board."
    default y
endmenu
```

## components/httpc/Kconfig
```kconfig
menu "HTTP Client"
config HTTP_CLIENT_MAX_HDR_VAL_LEN
    int "Maximum size of the HTTP header name and value"
    default 50
    help
        This option sets the maximum size for the HTTP header name and value fields separately
endmenu
```

## examples/amazon_aia/main/Kconfig.projbuild
```kconfig
menu "Voice Assistant Configurations"

config ALEXA_PRODUCT_ID
    string "Device Product ID"
    default "esp_alexa_open"
    help
        Product ID that will be used by the device to connect with AVS.

config VOICE_ASSISTANT_POP
    string "Device's proof-of-possession key"
    default "abcd1234"
    help
        Proof-of-possession is used for encrypted communication. Companion app uses default key for symmetric encryption and decryption of messages. If you change the key in the firmware, please modify the app too.

config VOICE_ASSISTANT_TASK_LIST
    bool "Enable task list print at delete stream"
    default n
    depends on FREERTOS_USE_STATS_FORMATTING_FUNCTIONS
    help
        Prints all the tasks which are running as well as blocked.

config ALEXA_AWS_ACCOUNT_ID
    string "AWS Account ID"
    default "XXX"
    help
        AWS Account ID for which AIS is white-listed.

config ALEXA_AWS_ENDPOINT
    string "AWS Endpoint"
    default "XXX"
    help
        AWS Endpoint to which the device should connect.

config ALEXA_ENABLE_CLOUD
    bool "Enable cloud support"
    default n
    help
        Enables app_cloud.h APIs for linking with a cloud for command and control. Default implementation of ESP RainMaker is available, and can be modified to any other such cloud.

endmenu
```

## examples/amazon_alexa/main/Kconfig.projbuild
```kconfig
menu "Voice Assistant Configurations"

config ALEXA_PRODUCT_ID
    string "Device Product ID"
    default "esp_alexa_open"
    help
        Product ID that will be used by the device to connect with AVS.

config VOICE_ASSISTANT_POP
    string "Device's proof-of-possession key"
    default "abcd1234"
    help
        Proof-of-possession is used for encrypted communication. Companion app uses default key for symmetric encryption and decryption of messages. If you change the key in the firmware, please modify the app too.

config ALEXA_REMOVE_SHORT_ALERT_SUPPORT
    bool "Remove the support for short alerts"
    default n
    help
        Short alert tone plays if an alert has triggered and alerts is in the background. Enabling this removes the support for that.

config VOICE_ASSISTANT_TASK_LIST
    bool "Enable task list print at delete stream"
    default n
    depends on FREERTOS_USE_STATS_FORMATTING_FUNCTIONS
    help
        Prints all the tasks which are running as well as blocked.

config ALEXA_ENABLE_CLOUD
    bool "Enable cloud support"
    default n
    help
        Enables app_cloud.h APIs for linking with a cloud for command and control. Default implementation of ESP RainMaker is available, and can be modified to any other such cloud.

endmenu
```

## examples/amazon_alexa/sdkconfig.defaults
```kconfig
#
# Serial flasher config
#
CONFIG_ESPTOOLPY_PORT="/dev/cu.SLAB_USBtoUART"
CONFIG_ESPTOOLPY_BAUD_921600B=y
CONFIG_ESPTOOLPY_FLASHFREQ_80M=y
CONFIG_ESPTOOLPY_FLASHSIZE_16MB=y
CONFIG_ESPTOOLPY_FLASHMODE_QIO=y

#
# Partition Table
#
CONFIG_PARTITION_TABLE_CUSTOM=y
CONFIG_PARTITION_TABLE_CUSTOM_FILENAME="partitions.csv"

#
# Compiler options
#
CONFIG_COMPILER_OPTIMIZATION_SIZE=y

#
# ESP32-specific
#
CONFIG_ESP32_REV_MIN_0=y
CONFIG_ESP32_DEFAULT_CPU_FREQ_240=y
CONFIG_ESP32_SPIRAM_SUPPORT=y

#
# SPI RAM config
#
CONFIG_SPIRAM_BOOT_INIT=y
CONFIG_SPIRAM_USE_MALLOC=y
CONFIG_SPIRAM_SPEED_80M=y
CONFIG_SPIRAM_MEMTEST=y
CONFIG_SPIRAM_CACHE_WORKAROUND=y
CONFIG_SPIRAM_MALLOC_ALWAYSINTERNAL=8190
CONFIG_SPIRAM_TRY_ALLOCATE_WIFI_LWIP=y
CONFIG_SPIRAM_MALLOC_RESERVE_INTERNAL=32768
CONFIG_SPIRAM_ALLOW_STACK_EXTERNAL_MEMORY=y
CONFIG_SPIRAM_ALLOW_BSS_SEG_EXTERNAL_MEMORY=y
CONFIG_SPIRAM_BANKSWITCH_ENABLE=n

#
# Common ESP-related
#
CONFIG_ESP_SYSTEM_EVENT_TASK_STACK_SIZE=4096
CONFIG_ESP_MAIN_TASK_STACK_SIZE=6144
CONFIG_ESP_TIMER_TASK_STACK_SIZE=4096
CONFIG_ESP_SYSTEM_PANIC_GDBSTUB=y
CONFIG_ESP_TASK_WDT_PANIC=y
CONFIG_ESP_INT_WDT_TIMEOUT_MS=5000

#
# Wi-Fi
#
CONFIG_ESP32_WIFI_STATIC_TX_BUFFER_NUM=32
CONFIG_ESP32_WIFI_STATIC_TX_BUFFER=y
CONFIG_ESP32_WIFI_TX_BUFFER_TYPE=0
CONFIG_ESP32_WIFI_STATIC_RX_BUFFER_NUM=12
CONFIG_ESP32_WIFI_DYNAMIC_RX_BUFFER_NUM=20
CONFIG_ESP32_WIFI_AMPDU_TX_ENABLED=n

#
# FreeRTOS
#
CONFIG_FREERTOS_IDLE_TASK_STACKSIZE=1024
CONFIG_FREERTOS_SUPPORT_STATIC_ALLOCATION=y
CONFIG_FREERTOS_TIMER_TASK_STACK_DEPTH=6144
CONFIG_FREERTOS_USE_TRACE_FACILITY=y
CONFIG_FREERTOS_WATCHPOINT_END_OF_STACK=y
CONFIG_FREERTOS_CHECK_MUTEX_GIVEN_BY_OWNER=n

#
# Log output
#
CONFIG_LOG_DEFAULT_LEVEL_INFO=y
CONFIG_LOG_DEFAULT_LEVEL=3

#
# LWIP
#
CONFIG_LWIP_MAX_SOCKETS=10
CONFIG_LWIP_USE_ONLY_LWIP_SELECT=y
CONFIG_LWIP_ETHARP_TRUST_IP_MAC=y
CONFIG_LWIP_DHCP_MAX_NTP_SERVERS=3
CONFIG_LWIP_L2_TO_L3_COPY=y

#
# TCP
#
CONFIG_LWIP_MAX_ACTIVE_TCP=8
CONFIG_LWIP_MAX_LISTENING_TCP=8
CONFIG_LWIP_TCP_SND_BUF_DEFAULT=14360
CONFIG_LWIP_TCP_WND_DEFAULT=14360
CONFIG_LWIP_TCP_RECVMBOX_SIZE=12

#
# PThreads
#
CONFIG_PTHREAD_TASK_PRIO_DEFAULT=4
CONFIG_PTHREAD_TASK_STACK_SIZE_DEFAULT=16000

#
# mbedTLS
#
# CONFIG_MBEDTLS_HAVE_TIME=y
# CONFIG_MBEDTLS_HAVE_TIME_DATE=y
CONFIG_MBEDTLS_EXTERNAL_MEM_ALLOC=y
CONFIG_MBEDTLS_HARDWARE_AES=n

#
# ESP HTTP client
#
CONFIG_ESP_HTTP_CLIENT_ENABLE_HTTPS=y

#
# SPI Flash driver
#
CONFIG_SPI_FLASH_YIELD_DURING_ERASE=y

#
# Bluetooth
#
CONFIG_BT_ENABLED=y
CONFIG_BT_STACK_NO_LOG=y
CONFIG_BTDM_CTRL_MODE_BLE_ONLY=y
```

## examples/google_dialogflow/main/Kconfig.projbuild
```kconfig
menu "Voice Assistant Configurations"

config VOICE_ASSISTANT_TASK_LIST
    bool "Enable task list print at delete stream"
    default n
    depends on FREERTOS_USE_STATS_FORMATTING_FUNCTIONS
    help
        Prints all the tasks which are running as well as blocked.

endmenu
```

## examples/google_voice_assistant/sdkconfig.defaults
```kconfig
#
# Serial flasher config
#
CONFIG_ESPTOOLPY_PORT="/dev/cu.SLAB_USBtoUART"
CONFIG_ESPTOOLPY_BAUD_921600B=y
CONFIG_ESPTOOLPY_BAUD=921600
CONFIG_ESPTOOLPY_FLASHFREQ_80M=y
CONFIG_ESPTOOLPY_FLASHFREQ="80m"
CONFIG_ESPTOOLPY_FLASHSIZE_8MB=y
CONFIG_ESPTOOLPY_FLASHSIZE="8MB"
CONFIG_FLASHMODE_QIO=y

#
# Partition Table
#
CONFIG_PARTITION_TABLE_CUSTOM=y
CONFIG_PARTITION_TABLE_CUSTOM_FILENAME="partitions.csv"
CONFIG_PARTITION_TABLE_FILENAME="partitions.csv"

#
# Compiler options
#
CONFIG_OPTIMIZATION_LEVEL_RELEASE=y

#
# ESP32-specific
#
CONFIG_ESP32_DEFAULT_CPU_FREQ_240=y
CONFIG_ESP32_DEFAULT_CPU_FREQ_MHZ=240
CONFIG_SPIRAM_SUPPORT=y

#
# SPI RAM config
#
CONFIG_SPIRAM_BOOT_INIT=y
CONFIG_SPIRAM_USE_MALLOC=y
CONFIG_SPIRAM_SPEED_80M=y
CONFIG_SPIRAM_MEMTEST=y
CONFIG_SPIRAM_CACHE_WORKAROUND=y
CONFIG_SPIRAM_MALLOC_ALWAYSINTERNAL=8190
CONFIG_WIFI_LWIP_ALLOCATION_FROM_SPIRAM_FIRST=y
CONFIG_SPIRAM_MALLOC_RESERVE_INTERNAL=32768
CONFIG_SPIRAM_ALLOW_STACK_EXTERNAL_MEMORY=y
CONFIG_SYSTEM_EVENT_TASK_STACK_SIZE=4096
CONFIG_MAIN_TASK_STACK_SIZE=6144
CONFIG_TIMER_TASK_STACK_SIZE=4096
CONFIG_ESP32_PANIC_GDBSTUB=y
CONFIG_TASK_WDT_PANIC=y

#
# Wi-Fi
#
CONFIG_ESP32_WIFI_STATIC_TX_BUFFER_NUM=32
CONFIG_ESP32_WIFI_STATIC_TX_BUFFER=y
CONFIG_ESP32_WIFI_TX_BUFFER_TYPE=0
CONFIG_ESP32_WIFI_STATIC_RX_BUFFER_NUM=10
CONFIG_ESP32_WIFI_DYNAMIC_RX_BUFFER_NUM=32

#
# Bluetooth
#
CONFIG_BT_ENABLED=y

#
# Bluetooth controller
#
CONFIG_BTDM_CONTROLLER_MODE_BLE_ONLY=y

#
# ESP HTTP client
#
CONFIG_ESP_HTTP_CLIENT_ENABLE_HTTPS=n

#
# FreeRTOS
#
CONFIG_FREERTOS_IDLE_TASK_STACKSIZE=1024
CONFIG_SUPPORT_STATIC_ALLOCATION=y
CONFIG_TIMER_TASK_STACK_DEPTH=6144
CONFIG_FREERTOS_USE_TRACE_FACILITY=y
CONFIG_FREERTOS_WATCHPOINT_END_OF_STACK=y

#
# LWIP
#
CONFIG_LWIP_MAX_SOCKETS=4
CONFIG_USE_ONLY_LWIP_SELECT=y
CONFIG_LWIP_ETHARP_TRUST_IP_MAC=y
CONFIG_LWIP_DHCP_MAX_NTP_SERVERS=3

#
# TCP
#
CONFIG_LWIP_MAX_ACTIVE_TCP=8
CONFIG_LWIP_MAX_LISTENING_TCP=8
CONFIG_TCP_SND_BUF_DEFAULT=14360
CONFIG_TCP_WND_DEFAULT=14360
CONFIG_TCP_RECVMBOX_SIZE=12

#
# PThreads
#
CONFIG_ESP32_PTHREAD_TASK_PRIO_DEFAULT=4
CONFIG_ESP32_PTHREAD_TASK_STACK_SIZE_DEFAULT=16000

#
# mbedTLS
#
CONFIG_MBEDTLS_HAVE_TIME=y
CONFIG_MBEDTLS_HAVE_TIME_DATE=y
```

## examples/lyrat_alexa/main/Kconfig.projbuild
```kconfig
menu "Example Configuration"

config USE_POP
       bool "Use Proof-of-possession"
       default n
       help
            If to use proof-of-possession. Only supported for security1

config POP
        string "proof-of-possession"
        depends on USE_POP
        default ""
        help
            proof of possession, which indicates that
            owner has physical access to the device
endmenu
```

## examples/lyrat_sr/sdkconfig.defaults
```kconfig
#
# Bootloader config
#
CONFIG_BOOTLOADER_SPI_WP_PIN=7

#
# Serial flasher config
#
CONFIG_ESPTOOLPY_PORT="/dev/cu.SLAB_USBtoUART"
CONFIG_ESPTOOLPY_BAUD_921600B=y
CONFIG_ESPTOOLPY_BAUD=921600
CONFIG_FLASHMODE_QIO=y
CONFIG_ESPTOOLPY_FLASHFREQ_80M=y
CONFIG_ESPTOOLPY_FLASHFREQ="80m"
CONFIG_ESPTOOLPY_FLASHSIZE_8MB=y
CONFIG_ESPTOOLPY_FLASHSIZE="8MB"

#
# Example Configuration
#
CONFIG_USE_POP=y
CONFIG_POP="abcd1234"

#
# Partition Table
#
CONFIG_PARTITION_TABLE_CUSTOM=y
CONFIG_PARTITION_TABLE_FILENAME="partitions.csv"

#
# ESP32-specific
#
CONFIG_ESP32_DEFAULT_CPU_FREQ_240=y
CONFIG_ESP32_DEFAULT_CPU_FREQ_MHZ=240
CONFIG_SPIRAM_SUPPORT=y

#
# SPI RAM config
#
CONFIG_SPIRAM_BOOT_INIT=y
CONFIG_SPIRAM_USE_MALLOC=y
CONFIG_SPIRAM_TYPE_ESPPSRAM32=y
CONFIG_SPIRAM_SIZE=4194304
CONFIG_SPIRAM_SPEED_80M=y
CONFIG_SPIRAM_MEMTEST=y
CONFIG_SPIRAM_CACHE_WORKAROUND=y
CONFIG_SPIRAM_MALLOC_ALWAYSINTERNAL=8190
CONFIG_WIFI_LWIP_ALLOCATION_FROM_SPIRAM_FIRST=y
CONFIG_SPIRAM_MALLOC_RESERVE_INTERNAL=32768
CONFIG_SPIRAM_ALLOW_STACK_EXTERNAL_MEMORY=y
CONFIG_SYSTEM_EVENT_TASK_STACK_SIZE=4096
CONFIG_MAIN_TASK_STACK_SIZE=14000
CONFIG_TIMER_TASK_STACK_SIZE=4096
CONFIG_ESP32_PANIC_PRINT_REBOOT=y

#
# Wi-Fi
#
CONFIG_ESP32_WIFI_DYNAMIC_RX_BUFFER_NUM=32
CONFIG_ESP32_WIFI_STATIC_TX_BUFFER=y
CONFIG_ESP32_WIFI_TX_BUFFER_TYPE=0
CONFIG_ESP32_WIFI_STATIC_TX_BUFFER_NUM=32
CONFIG_ESP32_WIFI_TASK_PINNED_TO_CORE_1=y

#
# FreeRTOS
#
CONFIG_FREERTOS_IDLE_TASK_STACKSIZE=1024
CONFIG_SUPPORT_STATIC_ALLOCATION=y
CONFIG_TIMER_TASK_STACK_DEPTH=6144
CONFIG_FREERTOS_USE_TRACE_FACILITY=y

#
# LWIP
#
CONFIG_LWIP_MAX_SOCKETS=4
CONFIG_USE_ONLY_LWIP_SELECT=y
CONFIG_LWIP_ETHARP_TRUST_IP_MAC=y
CONFIG_LWIP_DHCP_MAX_NTP_SERVERS=3

#
# TCP
#
CONFIG_LWIP_MAX_ACTIVE_TCP=8
CONFIG_LWIP_MAX_LISTENING_TCP=8
CONFIG_TCP_SND_BUF_DEFAULT=14360
CONFIG_TCP_WND_DEFAULT=14360
CONFIG_TCP_RECVMBOX_SIZE=12

#
# PThreads
#
CONFIG_ESP32_PTHREAD_TASK_PRIO_DEFAULT=4
CONFIG_ESP32_PTHREAD_TASK_STACK_SIZE_DEFAULT=16000
```
